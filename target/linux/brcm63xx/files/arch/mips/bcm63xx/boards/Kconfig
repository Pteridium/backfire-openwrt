## target/linux/brcm63xx/files/arch/mips/bcm63xx/boards/Kconfig
```kconfig
choice
	prompt "Board support"
	depends on BCM63XX
	default BOARD_BCM963XX

config BOARD_BCM963XX
       bool "Generic Broadcom 963xx boards"
	select SSB
       help

config BOARD_LIVEBOX
	bool "Inventel Livebox(es) boards"
	select SSB
	help
	 Inventel Livebox boards using the RedBoot bootloader.

endchoice
```
